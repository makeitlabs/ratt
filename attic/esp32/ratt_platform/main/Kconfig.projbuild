## attic/esp32/ratt_platform/main/Kconfig.projbuild
```kconfig
menu "Example Configuration"

config WIFI_SSID
    string "WiFi SSID"
	default "myssid"
	help
		SSID (network name) for the example to connect to.

config WIFI_PASSWORD
    string "WiFi Password"
	default "mypassword"
	help
		WiFi password (WPA or WPA2) for the example to use.

		Can be left blank if the network has no security set.

config WEB_SERVER
    string "Web Server Address"
	default "192.168.0.1"
	help
		Address for the web server - IP or resolvable name.

config WEB_PORT
    string "Web Server Port (HTTPS)"
	default "443"
	help
		Port on which the secure web server is running.

config WEB_URL_PATH
    string "URL Path"
	default "auth/api/v1/resources/resname/acl"
	help
		The path portion of the URL to fetch, empty string is root.

config WEB_BASIC_AUTH_USER
    string "Basic authentication username."
	default "foo"
	help
		The username for basic authentication.

config WEB_BASIC_AUTH_PASS
    string "Basic authentication password."
	default "bar"
	help
		The password for basic authentication.

config CLIENT_PK_PASSPHRASE
    string "Passphrase for the client private key."
	default "secret"
	help
		The passphrase to unlock the private key, configured during certificate setup.

endmenu
```

## firmware/rpi/yocto-build/conf/bblayers.conf
```bitbake
# POKY_BBLAYERS_CONF_VERSION is increased each time build/conf/bblayers.conf
# changes incompatibly
POKY_BBLAYERS_CONF_VERSION = "2"

BBPATH = "${TOPDIR}"
BBFILES ?= ""

BBLAYERS ?= " \
  /u/rpi/poky-dunfell/meta \
  /u/rpi/poky-dunfell/meta-poky \
  /u/rpi/poky-dunfell/meta-openembedded/meta-oe \
  /u/rpi/poky-dunfell/meta-openembedded/meta-multimedia \
  /u/rpi/poky-dunfell/meta-openembedded/meta-networking \
  /u/rpi/poky-dunfell/meta-openembedded/meta-perl \
  /u/rpi/poky-dunfell/meta-openembedded/meta-python \
  /u/rpi/poky-dunfell/meta-qt5 \
  /u/rpi/poky-dunfell/meta-raspberrypi \
  /u/rpi/poky-dunfell/meta-security \
  ${HOME}/ratt/firmware/rpi/meta-jumpnow \
  ${HOME}/ratt/firmware/rpi/meta-mender/meta-mender-core \
  ${HOME}/ratt/firmware/rpi/meta-mender/meta-mender-demo \
  ${HOME}/ratt/firmware/rpi/meta-mender/meta-mender-raspberrypi \
  ${HOME}/ratt/firmware/rpi/meta-ratt \
  "
```

## firmware/yocto-build/conf/bblayers.conf
```bitbake
# POKY_BBLAYERS_CONF_VERSION is increased each time build/conf/bblayers.conf
# changes incompatibly
POKY_BBLAYERS_CONF_VERSION = "2"

BBPATH = "${TOPDIR}"
BBFILES ?= ""

BBLAYERS ?= " \
  ${HOME}/yocto-ratt/poky-dunfell/meta \
  ${HOME}/yocto-ratt/poky-dunfell/meta-poky \
  ${HOME}/yocto-ratt/poky-dunfell/meta-openembedded/meta-oe \
  ${HOME}/yocto-ratt/poky-dunfell/meta-openembedded/meta-multimedia \
  ${HOME}/yocto-ratt/poky-dunfell/meta-openembedded/meta-networking \
  ${HOME}/yocto-ratt/poky-dunfell/meta-openembedded/meta-perl \
  ${HOME}/yocto-ratt/poky-dunfell/meta-openembedded/meta-python \
  ${HOME}/yocto-ratt/poky-dunfell/meta-qt5 \
  ${HOME}/yocto-ratt/poky-dunfell/meta-raspberrypi \
  ${HOME}/yocto-ratt/poky-dunfell/meta-security \
  ${HOME}/yocto-ratt/poky-dunfell/meta-jumpnow \
  ${HOME}/yocto-ratt/poky-dunfell/meta-mender/meta-mender-core \
  ${HOME}/yocto-ratt/poky-dunfell/meta-mender/meta-mender-demo \
  ${HOME}/yocto-ratt/poky-dunfell/meta-mender/meta-mender-raspberrypi \
  ${TOPDIR}/../meta-ratt \
  "
```
